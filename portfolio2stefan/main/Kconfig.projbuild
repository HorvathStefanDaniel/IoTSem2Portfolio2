## portfolio2stefan/main/Kconfig.projbuild
```kconfig
menu "Project Configuration"

    config WIFI_SSID
        string "WiFi SSID"
        default "StefanIOT"
        help
            The SSID of the WiFi network to connect to.

    config WIFI_PASSWORD
        string "WiFi Password"
        default "stefaniot"
        help
            The password for the WiFi network.

    config MQTT_BROKER
        string "MQTT Broker URL"
        default "mqtt://192.168.1.93"
        help
            The URL of the MQTT broker to connect to (without authentication).

    config MQTT_COMMAND_TOPIC
        string "MQTT Command Topic"
        default "device/commands"
        help
            The MQTT topic to subscribe to for receiving commands.

    config MQTT_RESPONSE_TOPIC
        string "MQTT Response Topic"
        default "temperature/publish"
        help
            The MQTT topic to publish responses to.

    config MQTT_USERNAME
        string "MQTT Username"
        default "com.dl.mqtt"
        help
            The MQTT username. If no authentication is used this can be ignored.

    config MQTT_PASSWORD
        string "MQTT Password"
        default "avd85hfk"
        help
            The MQTT password. If no authentication is used this can be ignored.
endmenu
```
